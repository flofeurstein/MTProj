/******************************************************************************
  Filename:       ota.xcl
  Revised:        $Date: 2010-11-18 08:17:09 -0800 (Thu, 18 Nov 2010) $
  Revision:       $Revision: 24437 $

  Description:    XLINK command file for the MSP430 IAR C/EC++ Compiler.
  Notes:          This file targets the Texas Instruments MSP2618.

  Copyright 2008-2010 Texas Instruments Incorporated. All rights reserved.

  IMPORTANT: Your use of this Software is limited to those specific rights
  granted under the terms of a software license agreement between the user
  who downloaded the software, his/her employer (which must be your employer)
  and Texas Instruments Incorporated (the "License").  You may not use this
  Software unless you agree to abide by the terms of the License. The License
  limits your use, and you acknowledge, that the Software may not be modified,
  copied or distributed unless embedded on a Texas Instruments microcontroller
  or used solely and exclusively in conjunction with a Texas Instruments radio
  frequency transceiver, which is integrated into your product.  Other than for
  the foregoing purpose, you may not use, reproduce, copy, prepare derivative
  works of, modify, distribute, perform, display or sell this Software and/or
  its documentation for any purpose.

  YOU FURTHER ACKNOWLEDGE AND AGREE THAT THE SOFTWARE AND DOCUMENTATION ARE
  PROVIDED “AS IS” WITHOUT WARRANTY OF ANY KIND, EITHER EXPRESS OR IMPLIED,
  INCLUDING WITHOUT LIMITATION, ANY WARRANTY OF MERCHANTABILITY, TITLE,
  NON-INFRINGEMENT AND FITNESS FOR A PARTICULAR PURPOSE. IN NO EVENT SHALL
  TEXAS INSTRUMENTS OR ITS LICENSORS BE LIABLE OR OBLIGATED UNDER CONTRACT,
  NEGLIGENCE, STRICT LIABILITY, CONTRIBUTION, BREACH OF WARRANTY, OR OTHER
  LEGAL EQUITABLE THEORY ANY DIRECT OR INDIRECT DAMAGES OR EXPENSES
  INCLUDING BUT NOT LIMITED TO ANY INCIDENTAL, SPECIAL, INDIRECT, PUNITIVE
  OR CONSEQUENTIAL DAMAGES, LOST PROFITS OR LOST DATA, COST OF PROCUREMENT
  OF SUBSTITUTE GOODS, TECHNOLOGY, SERVICES, OR ANY CLAIMS BY THIRD PARTIES
  (INCLUDING BUT NOT LIMITED TO ANY DEFENSE THEREOF), OR OTHER SIMILAR COSTS.

  Should you have any questions regarding your right to use this Software,
  contact Texas Instruments Incorporated at www.TI.com.
******************************************************************************/

//*****************************************************************
//
// The memory areas of the MSP430F2618 microprocessor:
//
//   Peripheral units:                0 - 01FF
//
//   Information memory (FLASH):   1000 - 10FF
//
//   Read-write memory (RAM):      1100 - 30FF
//
//   Read-only memory (FLASH):     3100 - FFFF
//                                 10000-1FFFF
//
//*****************************************************************

//*****************************************************************
//
// The following segments are defined in this linker command file:
//
// Data read/write segments (RAM)
// ==============================
//
// segment     Restrictions    Usage
// -------     ------------    --------------------------
// DATA16_I    < 10000         Data16 initialized variables
// DATA16_Z    < 10000         Data16 zero initialized variables
// DATA16_N    < 10000         Data16 uninitialized variables
// DATA16_HEAP < 10000         Data16 heap used by malloc and free
// DATA20_I                    Data20 initialized variables
// DATA20_Z                    Data20 zero initialized variables
// DATA20_N                    Data20 uninitialized variables
// DATA20_HEAP                 Data20 heap used by malloc and free
// CSTACK      < 10000         Runtime stack
//
//
// Program and data read-only segments (FLASH)
// ===========================================
//
// segment     Restrictions    Usage
// -------     ------------    --------------------------
// INFO                        Information memory
// CSTART      < 10000         Program startup code
// CODE                        Program code
// ISR_CODE    < 10000         Program code for interrupt service routines
// DATA16_C    < 10000         Data16 constant data and string literals
// DATA16_ID   < 10000         Data16 initializers for DATA16_I
// DATA20_C                    Data20 constant data and string literals
// DATA20_ID                   Data20 initializers for DATA20_I

// XNV Boot    3100-31FF       Boot Loader XNV code.
// CHECKSUM    3200-3201       The linker places the checksum byte(s) in this segment.
// CSUM SHDW   3202-3203       The boot code copies checksum here to stop powerup sanity checks.
// INTVEC      3204-3243       Interrupt vectors, re-located to this IVEC2 area.
// Dead Space  3244-328B       Available to linker, but nothing fits?
// Preamble    328C-3297       The OTA 12-byte preamble - placed here for backwards compatibility.
// Program     3298-E1FF       All code restricted to < 0x10000 plus whatever other code fits.
// OSAL NV     E200-F9FF       Reserving 12 pages for use by OSAL NV.
// OTA Boot    FA00-FF3D       Boot Loader code.
// Locate the IVEC control Xfer routines in ivec.s43 immediately before the IVEC table.
// IVECX       FF3E-FFBD       Interrupt vectors, intercepted by boot loader.
// BSLSKEY     FFBE-FFBF       Bootstrap loader security key - don't use.
// IVEC        FFC0-FFFF       Interrupt xfer vectors.
// RESET       FFFE-FFFF       The reset vector.
//
//*****************************************************************

-D_XNV_BOOT_BEG=0x3100
-D_XNV_BOOT_END=0x31FF
-DIVEC2_BEG=0x3204
-DIVEC2_END=0x3243
-D_LO_ROM_BEG=0x3204
-D_LO_ROM_END=0xE1FF
-D_ZIGNV_BEG=0xE200
-D_ZIGNV_END=0xF9FF
-D_OTA_BOOT_BEG=0xFA00
-D_OTA_BOOT_END=0xFF3D
-DIVECX_BEG=0xFF3E
-DIVECX_END=0xFFBD
-D_HI_ROM_BEG=0x10000
-D_HI_ROM_END=0x1FFFF

// ---------------------------------------------------------
// Define cpu.

-cmsp430

// ---------------------------------------------------------
// Read-write memory.

-Z(DATA)DATA16_I,DATA16_Z,DATA16_N,DATA16_HEAP+_DATA16_HEAP_SIZE=1100-30FF
-Z(DATA)CSTACK+_STACK_SIZE#

// ---------------------------------------------------------
// Information memory

-Z(CODE)INFO=1000-10FF
-Z(CODE)INFOA=10C0-10FF
-Z(CODE)INFOB=1080-10BF
-Z(CODE)INFOC=1040-107F
-Z(CODE)INFOD=1000-103F

-Z(CONST)CRC=3200-3203

// ---------------------------------------------------------
// Interrupt vectors

-Z(CODE)INTVEC=IVEC2_BEG-IVEC2_END
-Z(CODE)RESET=(IVEC2_END-1)-IVEC2_END

-Z(CONST)PREAMBLE=328C-3297

// ---------------------------------------------------------
// Low memory only Code

-Z(CODE)CSTART,ISR_CODE=_LO_ROM_BEG-_LO_ROM_END

// ---------------------------------------------------------
// Internal flash used for NV address space.

-Z(CODE)ZIGNV_ADDRESS_SPACE=_ZIGNV_BEG-_ZIGNV_END

// ---------------------------------------------------------
// Constant data

-P(CONST)DATA16_C,DATA16_ID,DIFUNCT=_LO_ROM_BEG-_LO_ROM_END
-P(CONST)DATA20_C,DATA20_ID=_LO_ROM_BEG-_LO_ROM_END

// ---------------------------------------------------------
// Code

-P(CODE)CODE=_LO_ROM_BEG-_LO_ROM_END,_HI_ROM_BEG-_HI_ROM_END

// The following must coincide with the correspondingly-named *_ADDR definitions in hal_ota.h.
-Z(CODE)HAL_OTA_CHKDL_SEG=0xFDF8-0xFE85
-Z(CODE)HAL_OTA_INVRC_SEG=0xFE86-0xFEBF
-Z(CODE)HAL_OTA_AVAIL_SEG=0xFEC0-0xFEC5
-Z(CODE)HAL_OTA_READ_SEG=0xFEC6-0xFF31
-Z(CODE)HAL_OTA_WRITE_SEG=0xFF32-_OTA_BOOT_END
-P(CODE)HAL_BOOT_SEG=_OTA_BOOT_BEG-_OTA_BOOT_END
-P(CODE)HAL_XNV_SEG=_XNV_BOOT_BEG-_XNV_BOOT_END

// Table of the IVEC re-directs.
-Z(CODE)IVECX=IVECX_BEG-IVECX_END
// Table of addresses allowing ISR to vector to the IVECX routines in ivec.s43.
-Z(CODE)IVEC=FFC0-FFFF

// Fill code gaps with 0xFFFF so that the CRC can be verified programatically.
-HFFFF
